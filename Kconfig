## Kconfig
```kconfig
menuconfig ZW3021
    bool "HLK-ZW3021 fingerprint sensor driver"
    depends on GPIO && SERIAL
    help
      Minimal evaluation driver for the HLK-ZW3021 fingerprint sensor.
      On finger placement (INT rising edge) it powers the sensor,
      performs PS_HandShake + PS_AutoIdentify (1:N match) over UART,
      and logs the result. Enrollment/delete/clear are driven separately
      via the behaviors below and queued to the same driver instance.

# These are BEHAVIOR_LOCALITY_GLOBAL behaviors: on a split build they must
# be compiled on every side (including ones without CONFIG_ZW3021, e.g. the
# BLE central) for ZMK to even recognize the keymap binding locally and
# forward it -- a side missing the device logs "No behavior assigned".
# Enable explicitly (CONFIG_ZW3021_xxx_BEHAVIOR=y) in every side's .conf
# that instantiates the corresponding devicetree node.
config ZW3021_ENROLL_BEHAVIOR
    bool "ZW3021 fingerprint enroll behavior"

config ZW3021_DELETE_BEHAVIOR
    bool "ZW3021 fingerprint delete behavior"

config ZW3021_CLEAR_BEHAVIOR
    bool "ZW3021 fingerprint database clear behavior"

if ZW3021

config ZW3021_STORAGE
    bool "Per-fingerprint-ID output string storage (NVS)"
    select NVS
    select TINYCRYPT
    select TINYCRYPT_AES
    select TINYCRYPT_AES_CTR
    select TINYCRYPT_SHA256
    select HWINFO
    help
      Stores one output string per fingerprint ID in a dedicated flash
      partition ("zw3021_partition", must be defined by the board/shield
      overlay -- see boards/shields/mona2/mona2_l.overlay in
      zmk-config-moNa2-v2 for the reference layout). On a successful
      PS_AutoIdentify match, the stored string is typed out character by
      character via a reserved block of virtual keymap positions. Strings
      are only ever written at runtime over the serial RPC interface
      (CONFIG_ZW3021_SERIAL_RPC); they never appear in git or in the
      compiled firmware image. Stored encrypted at rest (AES-128-CTR, key
      derived from the chip's own hardware ID at boot, never persisted --
      see src/storage.c for what this does and doesn't protect against).

config ZW3021_SERIAL_RPC
    bool "Serial RPC for managing per-ID output strings"
    depends on ZW3021_STORAGE
    help
      Adds a line-based JSON RPC server on the same USB CDC-ACM console
      used for logging (requires the zmk-usb-logging snippet). Lets you
      read/write/delete per-fingerprint-ID output strings and trigger
      enrollment without needing to flash new firmware or touch git.

config ZW3021_BLE_RPC
    bool "Standalone BLE GATT RPC for managing per-ID output strings"
    depends on ZW3021_STORAGE
    select BT_EXT_ADV
    help
      Adds the same JSON RPC command set as ZW3021_SERIAL_RPC, but over a
      second, independent BLE connection (its own GATT service and
      extended-advertising set) instead of USB -- unrelated to ZMK Studio
      or the split link to the central half. Requires
      CONFIG_BT_MAX_CONN and CONFIG_BT_EXT_ADV_MAX_ADV_SET to be at least
      2 in the board's .conf (one for the existing split link, one for
      this connection); this option only selects BT_EXT_ADV itself.

endif # ZW3021
```

## dts/bindings/behaviors/razilyis,zw3021-clear.yaml
```yaml
description: |
  Erase the entire ZW3021 fingerprint database (PS_Empty).
  BEHAVIOR_LOCALITY_GLOBAL: on a split build this runs on every side; only
  the side with CONFIG_ZW3021 (the physical sensor) actually does anything.

compatible: "razilyis,zw3021-clear"

include: zero_param.yaml
```

## dts/bindings/behaviors/razilyis,zw3021-delete.yaml
```yaml
description: |
  Delete the ZW3021 fingerprint template stored at the given ID.
  BEHAVIOR_LOCALITY_GLOBAL: on a split build this runs on every side; only
  the side with CONFIG_ZW3021 (the physical sensor) actually does anything.

compatible: "razilyis,zw3021-delete"

include: one_param.yaml
```

## dts/bindings/behaviors/razilyis,zw3021-enroll.yaml
```yaml
description: |
  Start ZW3021 fingerprint enrollment for the given ID (1:1 slot).
  BEHAVIOR_LOCALITY_GLOBAL: on a split build this runs on every side; only
  the side with CONFIG_ZW3021 (the physical sensor) actually does anything.

compatible: "razilyis,zw3021-enroll"

include: one_param.yaml
```

## dts/bindings/razilyis,zw3021.yaml
```yaml
description: HLK-ZW3021 fingerprint sensor (minimal evaluation driver)

compatible: "razilyis,zw3021"

include: uart-device.yaml

properties:
  int-gpios:
    type: phandle-array
    required: true
    description: |
      GPIO connected to the sensor INT pin. Idle low, rises to high
      while a finger is on the sensor (rising edge = finger placed).

  power-en-gpios:
    type: phandle-array
    required: true
    description: |
      GPIO connected to the VCC-D load switch enable pin. Active high:
      driving it high powers the sensor's DSP (VCC-D) on.

  power-on-delay-ms:
    type: int
    default: 200
    description: |
      Delay after enabling VCC-D before starting to wait for the
      sensor's boot indication.

  startup-timeout-ms:
    type: int
    default: 500
    description: |
      Maximum time to wait for the sensor's 0x55 boot byte before
      falling back to PS_HandShake for boot confirmation.

  identify-timeout-ms:
    type: int
    default: 12000
    description: |
      Upper bound for PS_AutoIdentify completion. The sensor has its
      own internal timeout (~8s by default per its BCH configuration
      register); this property is a host-side safety margin above
      that, guarding against a lost UART response.

  score-level:
    type: int
    default: 3
    description: PS_AutoIdentify match score level (1-5, 5 is strictest).
```
